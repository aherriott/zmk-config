/*
 * Copyright (c) 2020 The ZMK Contributors
 *
 * SPDX-License-Identifier: MIT
 */

#include <behaviors.dtsi>
#include <dt-bindings/zmk/keys.h>
#include <dt-bindings/zmk/mouse.h>
#include <dt-bindings/zmk/bt.h>

/**
 * Shorthand Macros
*/

#define DEFAULT		0
#define QWERTY		1
#define MOUSE		2
#define SYM			3
#define NAV			4
#define NUM			5
#define VSCODE		6

#define THUMB_NONE 		&none &none &none &none
#define XXX 			&none
#define THUMB_PASS		&trans &trans &trans &trans &trans &trans &trans &trans &trans

#define HYPER_M(X) LG(LA(LS(LC(X))))
#define HYPER LG(LA(LS(LCTRL)))

#define HRMLG &hrmls LGUI
#define HRMLA &hrmls LALT
#define HRMLS &hrml LSHIFT
#define HRMLSS &hrmls LSHIFT
#define HRMLC &hrmls LCTRL
#define HRMRC &hrmrs RCTRL
#define HRMRS &hrmr RSHIFT
#define HRMRSS &hrmrs RSHIFT
#define HRMRA &hrmrs RALT
#define HRMRG &hrmrs RGUI

// App switching (use with jumpapp on ubuntu, etc)
#define HYP_0 &kp HYPER_M(N0)
#define HYP_1 &kp HYPER_M(N1)
#define HYP_2 &kp HYPER_M(N2)
#define HYP_3 &kp HYPER_M(N3)
#define HYP_4 &kp HYPER_M(N4)
#define HYP_5 &kp HYPER_M(N5)
#define HYP_6 &kp HYPER_M(N6)

// Generic
#define S_SAVE		&kp LC(S)
#define S_FIND		&kp LC(F)
#define S_CMMNT		&kp LC(FSLH)
#define S_PASTE		&kp LC(V)
#define S_UNDO		&kp LC(Z)
#define S_REDO		&kp LC(Y)
#define WORD_LEFT	&kp LC(LEFT)
#define WORD_RIGHT  &kp LC(RIGHT)
#define SEL_L_LEFT	&kp	LS(HOME)
#define SEL_W_LEFT 	&kp LS(LC(LEFT))
#define SEL_W_RIGHT &kp	LS(LC(RIGHT))
#define SEL_L_RIGHT &kp LS(END)

// VSCode
#define HOME_FILE   &kp LC(HOME)
#define END_FILE    &kp LC(END)
#define PALLATE     &kp LC(LS(P))
#define MV_L_DOWN   &kp LA(DOWN)
#define MV_L_UP     &kp LA(UP)
#define TOG_TERM    &kp LC(GRAVE)
#define NEW_TERM    &kp LC(LS(GRAVE))
#define FTREE_TOG   &kp LC(B)
#define FILE_LEFT   &kp LC(PG_UP)
#define FILE_RIGHT  &kp LC(PG_DN)
#define BOX_LEFT    &kp LC(LS(LA(LEFT)))
#define BOX_UP      &kp LC(LS(LA(UP)))
#define BOX_DOWN    &kp LC(LS(LA(DOWN)))
#define BOX_RIGHT   &kp LC(LS(LA(RIGHT)))
#define TOG_WRDW    &kp LA(Z)
#define SEL_ALL_OC  &kp LC(LS(L))
#define CUR_DOWN    &kp LC(LA(UP))
#define CUR_UP      &kp LC(LA(DOWN))
#define CUR_UNDO    &kp LC(U)

/**
 * Key indices shorthand:
 * 1-5		6-10
 * 13-17	18-22
 * 25-29	34-38
 * 40-44	45-49
 */
#define KEYS_L	1  2  3  4  5	\
				13 14 15 16 17	\
				25 26 27 28 29
#define KEYS_R  6  7  8  9  10	\
				18 19 20 21 22	\
				34 35 36 37 38
#define KEYS_T	40 41 42 43 44	\
				45 46 47 48 49

/**
 * Helper Macros
 */

// Below helpers are copied from urob's implementation. Ideally they'd live in a separate file for clarity,
// but for now they need to live here so the layout-drawer can load it by the .keymap file alone.

#define ZMK_HELPER_STRINGIFY(x) #x

#define ZMK_BEHAVIOR_CORE_caps_word   compatible = "zmk,behavior-caps-word";  #binding-cells = <0>
#define ZMK_BEHAVIOR_CORE_hold_tap    compatible = "zmk,behavior-hold-tap";   #binding-cells = <2>
#define ZMK_BEHAVIOR_CORE_key_repeat  compatible = "zmk,behavior-key-repeat"; #binding-cells = <0>
#define ZMK_BEHAVIOR_CORE_macro       compatible = "zmk,behavior-macro";      #binding-cells = <0>
#define ZMK_BEHAVIOR_CORE_mod_morph   compatible = "zmk,behavior-mod-morph";  #binding-cells = <0>
#define ZMK_BEHAVIOR_CORE_sticky_key  compatible = "zmk,behavior-sticky-key"; #binding-cells = <1>
#define ZMK_BEHAVIOR_CORE_tap_dance   compatible = "zmk,behavior-tap-dance";  #binding-cells = <0>

#define ZMK_BEHAVIOR(name, type, ...) \
    / { \
        behaviors { \
            name: name { \
                label = ZMK_HELPER_STRINGIFY(ZB_ ## name); \
                ZMK_BEHAVIOR_CORE_ ## type; \
                __VA_ARGS__ \
            }; \
        }; \
    };

#define ZMK_MOD_SHIFT(name, base_key, shift_key) \
    / { \
        behaviors { \
            name: name { \
                compatible = "zmk,behavior-mod-morph"; \
                label = ZMK_HELPER_STRINGIFY(ZMK_MOD_SHIFT_ ## name); \
                #binding-cells = <0>; \
                bindings = <&kp base_key>, <&kp shift_key>; \
                mods = <(MOD_LSFT|MOD_RSFT)>; \
            }; \
        }; \
    };

/**
 * Mouse
 */

// Mouse movement
#define U_MOUSE_MOVE_MAX 1400                     /* <--- New max speed setting (default: 600) */

// MOVE_UP should only not be defined if we are building from the keymap-drawer
#ifdef MOVE_UP
	#undef MOVE_UP
	#undef MOVE_DOWN
	#undef MOVE_LEFT
	#undef MOVE_RIGHT
	#define MOVE_UP MOVE_VERT(-U_MOUSE_MOVE_MAX)
	#define MOVE_DOWN MOVE_VERT(U_MOUSE_MOVE_MAX)
	#define MOVE_LEFT MOVE_HOR(-U_MOUSE_MOVE_MAX)
	#define MOVE_RIGHT MOVE_HOR(U_MOUSE_MOVE_MAX)
#endif

&mmv {
	time-to-max-speed-ms = <400>;             /* <--- How long time until max speed is reached (default: 500) */
};

// Scroll
#define U_MOUSE_SCROLL_MAX 20                    /* <--- New max speed setting (default: 10) */

// SCROLL_UP should only not be defined if we are building from the keymap-drawer
#ifdef SCROLL_UP
	#undef SCROLL_UP
	#undef SCROLL_DOWN
	#undef SCROLL_LEFT
	#undef SCROLL_RIGHT
	#define SCROLL_UP SCROLL_VERT(U_MOUSE_SCROLL_MAX)
	#define SCROLL_DOWN SCROLL_VERT(-U_MOUSE_SCROLL_MAX)
	#define SCROLL_LEFT SCROLL_HOR(-U_MOUSE_SCROLL_MAX)
	#define SCROLL_RIGHT SCROLL_HOR(U_MOUSE_SCROLL_MAX)
#endif

&mwh {
  time-to-max-speed-ms = <500>;                 /* <--- How long time until max speed is reached */
};

/**
 * nice!view
 */

// Override nice_view_spi to use the correct CS pin
&spi0 {
	compatible = "nordic,nrf-spim";
	sck-pin = <20>;
	mosi-pin = <17>;
	miso-pin = <25>;
	cs-gpios = <&pro_micro 2 GPIO_ACTIVE_HIGH>; // "DATA" pin for TRRS
};
// &nice_view_spi: &spi0;

/**
 * Layer-tap & Mod-tap tweaks
 */

&lt {
	quick-tap-ms = <250>;
	tapping-term-ms = <130>;
};

&mt {
	quick-tap-ms = <250>;
	tapping-term-ms = <130>;
};

/**
 * Home row hold-taps
 */

/* left-hand HRMs */
ZMK_BEHAVIOR(hrml, hold_tap, 
	flavor = "balanced";
	tapping-term-ms = <130>;
	bindings = <&kp>, <&kp>;
	hold-trigger-key-positions = <KEYS_R KEYS_T>;
	global-quick-tap;
)

/* right-hand HRMs */
ZMK_BEHAVIOR(hrmr, hold_tap,
	flavor = "balanced";
	tapping-term-ms = <130>;
	bindings = <&kp>, <&kp>;
	hold-trigger-key-positions = <KEYS_L KEYS_T>;
	global-quick-tap;
)

/* left-hand HRMs slow */
ZMK_BEHAVIOR(hrmls, hold_tap, 
	flavor = "balanced";
	tapping-term-ms = <160>;
	bindings = <&kp>, <&kp>;
	hold-trigger-key-positions = <KEYS_R KEYS_T>;
	global-quick-tap;
)

/* right-hand HRMs slow */
ZMK_BEHAVIOR(hrmrs, hold_tap,
	flavor = "balanced";
	tapping-term-ms = <160>;
	bindings = <&kp>, <&kp>;
	hold-trigger-key-positions = <KEYS_L KEYS_T>;
	global-quick-tap;
)

/**
 * Tap Dances
*/

/* Tap copy, double tap cut */
ZMK_BEHAVIOR(copy_cut, tap_dance,
	tapping-term-ms = <250>;
	bindings = <&kp LC(C)>, <&kp LC(X)>;
)

/* Tap undo, double tap redo */
ZMK_BEHAVIOR(undo_redo, tap_dance,
	tapping-term-ms = <250>;
	bindings = <&kp LC(Z)>, <&kp LC(Y)>;
)

/* Tap back, double tap forward */
ZMK_BEHAVIOR(back_forward, tap_dance,
	tapping-term-ms = <250>;
	bindings = <&kp LA(LEFT)>, <&kp LA(RIGHT)>;
)

/* Tap find, double tap replace */
ZMK_BEHAVIOR(find_rep, tap_dance,
	tapping-term-ms = <250>;
	bindings = <&kp LC(F)>, <&kp LC(H)>;
)

/**
 * Custom shifted keys
 */

ZMK_MOD_SHIFT(comma_qmark, COMMA, QMARK)
ZMK_MOD_SHIFT(dot_excl, DOT, EXCL)
ZMK_MOD_SHIFT(fslh_bslh, FSLH, BSLH)

/**
 * Macros
*/

#define MACRO_WAIT_MS 20
#define MACRO_TAP_MS 20
#define END_DOT	&end_dot
ZMK_BEHAVIOR(end_dot, macro,
	wait-ms = <MACRO_WAIT_MS>;
	tap-ms = <MACRO_TAP_MS>;
	bindings = <&kp DOT &kp SPACE &sk LSHIFT>;
)
#define SCRL_UP	&scrl_up
ZMK_BEHAVIOR(scrl_up, macro,
	wait-ms = <MACRO_WAIT_MS>;
	tap-ms = <MACRO_TAP_MS>;
	bindings = <&kp UP &kp UP &kp UP &kp UP &kp UP>;
)
#define SCRL_DOWN &scrl_down
ZMK_BEHAVIOR(scrl_down, macro,
	wait-ms = <MACRO_WAIT_MS>;
	tap-ms = <MACRO_TAP_MS>;
	bindings = <&kp DOWN &kp DOWN &kp DOWN &kp DOWN &kp DOWN>;
)
#define DBL_PIPE &dbl_pipe
ZMK_BEHAVIOR(dbl_pipe, macro,
	wait-ms = <MACRO_WAIT_MS>;
	tap-ms = <MACRO_TAP_MS>;
	bindings = <&kp PIPE &kp PIPE>;
)
#define DBL_EQL &dbl_eql
ZMK_BEHAVIOR(dbl_eql, macro,
	wait-ms = <MACRO_WAIT_MS>;
	tap-ms = <MACRO_TAP_MS>;
	bindings = <&kp EQUAL &kp EQUAL>;
)
#define DBL_COLN &dbl_coln
ZMK_BEHAVIOR(dbl_coln, macro,
	wait-ms = <MACRO_WAIT_MS>;
	tap-ms = <MACRO_TAP_MS>;
	bindings = <&kp COLON &kp COLON>;
)
#define DDOT_SLSH &ddot_slsh
ZMK_BEHAVIOR(ddot_slsh, macro,
	wait-ms = <MACRO_WAIT_MS>;
	tap-ms = <MACRO_TAP_MS>;
	bindings = <&kp DOT &kp DOT &kp FSLH>;
)
#define SEL_LINE 	&sel_line
ZMK_BEHAVIOR(sel_line, macro,
	wait-ms = <MACRO_WAIT_MS>;
	tap-ms = <MACRO_TAP_MS>;
	bindings = <&kp HOME &kp LS(END)>;
)
// VSCode Macros
#define FOLD_REG &fold_reg
#define UNFOLD_REG &unfold_reg
#define ZEN_MODE &zen_mode
#define RVL_EXP &rvl_exp
ZMK_BEHAVIOR(fold_reg, macro,
	wait-ms = <MACRO_WAIT_MS>;
	tap-ms = <MACRO_TAP_MS>;
	bindings = <&kp LC(K) &kp LC(N0)>;
)
ZMK_BEHAVIOR(unfold_reg, macro,
	wait-ms = <MACRO_WAIT_MS>;
	tap-ms = <MACRO_TAP_MS>;
	bindings = <&kp LC(K) &kp LC(J)>;
)
ZMK_BEHAVIOR(zen_mode, macro,
	wait-ms = <MACRO_WAIT_MS>;
	tap-ms = <MACRO_TAP_MS>;
	bindings = <&kp LC(K) &kp Z>;
)
ZMK_BEHAVIOR(rvl_exp, macro,
	wait-ms = <MACRO_WAIT_MS>;
	tap-ms = <MACRO_TAP_MS>;
	bindings = <&kp LC(K) &kp R>;
)

/**
 * Combos
 * 
 * Key indices:
 * 0-5		6-11
 * 12-17	18-23
 * 24-29	34-39
 * 40-44	45-50
*/

/ {
	combos {
        compatible = "zmk,combos";
        combo_mouse_enter {
            timeout-ms = <50>;
            key-positions = <3 4>; /* F P */
            bindings = <&tog MOUSE>;
			layers = <DEFAULT>;
        };
		combo_mouse_enter_do_nothing {
            timeout-ms = <50>;
            key-positions = <3 4>; /* F P */
            bindings = <&none>;
			layers = <MOUSE>;
        };
		combo_exit_all {
			timeout-ms = <50>;
            key-positions = <7 8>; /* L U */
            bindings = <&to DEFAULT>;
		};
    };
};

/**
 * Keymap
*/

/ {
	keymap {
		compatible = "zmk,keymap";

		default {
			bindings = <
	XXX	&kp Q   	&kp W   	&kp F   &kp P   		&kp B                	&kp J			&kp L			&kp U           &kp Y      	&kp SEMI	XXX
	XXX	HRMLG A		HRMLA R		HRMLS S	HRMLC T			&kp G                   &kp M       	HRMRC N			HRMRS E  		HRMRA I		HRMRG O		XXX
	XXX	&kp Z   	&kp X   	&kp C   &kp D			&kp V		THUMB_NONE	&kp K       	&kp H   		&comma_qmark	&dot_excl	&fslh_bslh	XXX
		&tog QWERTY	&key_repeat	&kp DEL	&lt NAV BSPC	&lt NUM RET            	&lt VSCODE TAB 	&lt SYM SPACE	&kp ESC        	&key_repeat	&tog QWERTY
			>;

			sensor-bindings = <&inc_dec_kp PG_UP PG_DN &inc_dec_kp PG_UP PG_DN>;
		};

		qwerty {
			bindings = <
	XXX	&kp Q	&kp W  	&kp E  	&kp R  	&kp T                 &kp Y  	&kp U	&kp I     	&kp O   &kp P    	XXX  
	XXX	HRMLG A	HRMLA S	HRMLS D	HRMLC F	&kp G                 &kp H  	HRMRC J	HRMRS K		HRMRA L	HRMRG SEMI	XXX  
	XXX	&kp Z 	&kp X  	&kp C	&kp V  	&kp B   THUMB_NONE    &kp N  	&kp M  	&kp COMMA 	&kp DOT &kp FSLH    XXX  
												THUMB_PASS
			>;

			sensor-bindings = <&inc_dec_kp PG_UP PG_DN &inc_dec_kp PG_UP PG_DN>;
		};

		mouse {
			bindings = <
	XXX &mwh SCROLL_LEFT	XXX				XXX			&mwh SCROLL_RIGHT	XXX						XXX			XXX				XXX				XXX 			XXX				XXX
	XXX	&mwh SCROLL_DOWN	&mwh SCROLL_UP	&mkp RCLK	&mkp LCLK			&mkp MCLK				&bt BT_CLR	&bt BT_SEL 0	&bt BT_SEL 1	&bt BT_SEL 2	&bt BT_SEL 3	XXX
	XXX &kp LCTRL			&kp LALT		&kp LSHIFT	&kp LGUI			XXX			THUMB_NONE	XXX			XXX				XXX				XXX				XXX				XXX
																						THUMB_PASS
			>;

			sensor-bindings = <&inc_dec_kp PG_UP PG_DN &inc_dec_kp PG_UP PG_DN>;
		};

		/**
		*   Features (mostly ordered by importance):
		*		ENG: DOT, COMMA, QMARK, EXCL, AT
		*			SEMI, COLON, DQT, SQT
		* 		C: SEMI, EQUAL, LPAR, RPAR, LBRC, RBRC, UNDER,
		*			EXCL, SQT, DQT, PRCNT, STAR, PLUS, MINUS, LT, GT, LBKT, RBKT, AMPS, PIPE, HASH,
		* 			QMARK, 
		*		bash: SQT, DQT, TILDE, FSLH, DLLR, MINUS, AMPS, PIPE
		*			LBRC, RBRC, GT, STAR,
		*        
		*		Low usage: GRAVE, BSLH, CARET
		*/

		sym {
			bindings = <
	XXX	&kp PIPE	&kp PLUS	&kp AT			&kp LBRC	&kp RBRC               	&kp CARET	&kp PRCNT	&kp DLLR	&caps_word  DBL_COLN	XXX
	XXX	HRMLG AMPS	HRMLA MINUS	HRMLSS EQUAL	HRMLC LPAR	&kp RPAR				&kp TILDE	HRMRC SQT	HRMRSS DQT	HRMRA UNDER	HRMRG HASH	XXX
	XXX	DBL_PIPE	&kp STAR 	DBL_EQL			&kp LBKT	&kp RBKT	THUMB_NONE	&kp GRAVE	&kp LT		&kp GT		END_DOT		DDOT_SLSH	XXX
																		THUMB_PASS	&reset
			>;

			sensor-bindings = <&inc_dec_kp PG_UP PG_DN &inc_dec_kp PG_UP PG_DN>;
		};

		/**
		*   Features:
		*		Arrows (L hand): LEFT, RIGHT, UP, DOWN
		*		Mouse (L hand):  LEFT, RIGHT, MIDDLE, BACK, FORWARD
		*		Mods (L hand): LCTRL, LSHIFT, LALT
		*		Actions: Ctrl c, ctrl x, ctrl v, PRSCRN, Ctrl Z, Ctrl Y, ctrl S
		*		Media: 	C_VOL_UP, C_VOL_DN, C_MUTE, 
		*				video (ctrl alt v), screenshare (ctrl alt s), leave (ctrl alt e)
		*		BT: BT_NEXT, BT_CLR
		*
		* missing: hbt BT_CLR BT_NXT
		*/

		nav {
			bindings = <
	XXX &kp HOME	&back_forward	&find_rep	&kp END		&kp PSCRN	       			&kp F10	&kp F7	&kp F8	&kp F9	&kp F13	XXX
	XXX	&kp LEFT	&kp UP			&kp DOWN	&kp RIGHT	S_SAVE						&kp F11	&kp F4	&kp F5	&kp F6	&kp F14	XXX
	XXX	S_UNDO		S_REDO			&copy_cut	S_PASTE		S_CMMNT		THUMB_NONE 		&kp F12	&kp F1	&kp F2	&kp F3	&kp F15	XXX
															&reset		THUMB_PASS
		>;

			sensor-bindings = <&inc_dec_kp PG_UP PG_DN &inc_dec_kp PG_UP PG_DN>;
		};

		num {
			bindings = <
	XXX	WORD_LEFT 	SCRL_UP		SCRL_DOWN	WORD_RIGHT	SEL_LINE					&kp PRCNT	&kp N7	&kp N8	&kp N9	&kp COLON	XXX
	XXX	&sk LGUI	&sk LALT	&sk LSHIFT	&sk LCTRL	&key_repeat					&kp DOT		&kp N4	&kp N5	&kp N6	&kp N0		XXX
	XXX	HYP_4		HYP_3		HYP_2		HYP_1		HYP_0			THUMB_NONE	&kp COMMA	&kp N1	&kp N2	&kp N3	&fslh_bslh	XXX
														&bootloader		THUMB_PASS
			>;

			sensor-bindings = <&inc_dec_kp PG_UP PG_DN &inc_dec_kp PG_UP PG_DN>;
		};

		vscode {
			bindings = <
	XXX	SEL_W_LEFT	SEL_L_LEFT 	SEL_L_RIGHT	SEL_W_RIGHT	FOLD_REG					PALLATE		HOME_FILE	MV_L_DOWN	MV_L_UP		END_FILE	XXX
	XXX	&sk LGUI	&sk LALT	&sk LSHIFT	&sk LCTRL	&key_repeat					ZEN_MODE	FILE_LEFT	TOG_TERM	FTREE_TOG	FILE_RIGHT	XXX
	XXX	BOX_LEFT	BOX_UP		BOX_DOWN	BOX_RIGHT	UNFOLD_REG     	THUMB_NONE 	TOG_WRDW	RVL_EXP		CUR_DOWN	CUR_UP		CUR_UNDO	XXX
																		THUMB_PASS	&bootloader
			>;

			sensor-bindings = <&inc_dec_kp PG_UP PG_DN &inc_dec_kp PG_UP PG_DN>;
		};
	};
};
