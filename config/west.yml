## config/west.yml
```yaml
manifest:
  remotes:
    - name: my_zmk
      url-base: https://github.com/aherriott
  projects:
    - name: zmk
      remote: my_zmk
      revision: main
      import: app/west.yml
  self:
    path: config
```
